## conf/layer.conf
```bitbake
BBFILES += "${LAYERDIR}/recipes*/*/*.bb ${LAYERDIR}/recipes*/*/*.bbappend"
BBPATH .= ":${LAYERDIR}"
BBFILE_COLLECTIONS += "meta-pixie"
BBFILE_PRIORITY_meta-pixie = "17"
BBFILE_PATTERN_meta-pixie := "^${LAYERDIR}/"
```
